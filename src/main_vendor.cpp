// Vendor-baseline + custom-shim diagnostic for the JC3248W535 AXS15231B.
//
// Uses the MANUFACTURER'S ESP-IDF panel driver (src/vendor/esp_lcd_axs15231b.c)
// via a CUSTOM esp_lcd_panel_io_t shim (src/vendor/my_panel_io.c) that handles
// the QSPI wire framing. This side-steps the missing `quad_mode` flag in stock
// arduino-esp32 3.0.17 while keeping all vendor-sequencing logic intact.
//
// Guarded so that only the jc3248w535_vendor env compiles this TU.

#ifdef BOARD_IS_JC3248W535_VENDOR

#include <Arduino.h>
#include <Wire.h>
#include <driver/spi_master.h>
#include <driver/ledc.h>
#include <esp_heap_caps.h>
#include <esp_lcd_panel_io.h>
#include <esp_lcd_panel_vendor.h>
#include <esp_lcd_panel_ops.h>

extern "C" {
#include "vendor/esp_lcd_axs15231b.h"
#include "vendor/my_panel_io.h"
}

#define PIN_QSPI_CS   45
#define PIN_QSPI_SCK  47
#define PIN_QSPI_D0   21
#define PIN_QSPI_D1   48
#define PIN_QSPI_D2   40
#define PIN_QSPI_D3   39
#define PIN_BL         1
#define PIN_SDA        4
#define PIN_SCL        8

#define LCD_W 320
#define LCD_H 480

static spi_device_handle_t        g_spi   = nullptr;
static esp_lcd_panel_io_handle_t  g_io    = nullptr;
static esp_lcd_panel_handle_t     g_panel = nullptr;

// Vendor BSP override init table (from esp_bsp.c lines 34-67).
static const axs15231b_lcd_init_cmd_t kInitCmds[] = {
    {0xBB, (uint8_t[]){0x00,0x00,0x00,0x00,0x00,0x00,0x5A,0xA5}, 8, 0},
    {0xA0, (uint8_t[]){0xC0,0x10,0x00,0x02,0x00,0x00,0x04,0x3F,0x20,0x05,0x3F,0x3F,0x00,0x00,0x00,0x00,0x00}, 17, 0},
    {0xA2, (uint8_t[]){0x30,0x3C,0x24,0x14,0xD0,0x20,0xFF,0xE0,0x40,0x19,0x80,0x80,0x80,0x20,0xF9,0x10,0x02,0xFF,0xFF,0xF0,0x90,0x01,0x32,0xA0,0x91,0xE0,0x20,0x7F,0xFF,0x00,0x5A}, 31, 0},
    {0xD0, (uint8_t[]){0xE0,0x40,0x51,0x24,0x08,0x05,0x10,0x01,0x20,0x15,0x42,0xC2,0x22,0x22,0xAA,0x03,0x10,0x12,0x60,0x14,0x1E,0x51,0x15,0x00,0x8A,0x20,0x00,0x03,0x3A,0x12}, 30, 0},
    {0xA3, (uint8_t[]){0xA0,0x06,0xAA,0x00,0x08,0x02,0x0A,0x04,0x04,0x04,0x04,0x04,0x04,0x04,0x04,0x04,0x04,0x04,0x04,0x00,0x55,0x55}, 22, 0},
    {0xC1, (uint8_t[]){0x31,0x04,0x02,0x02,0x71,0x05,0x24,0x55,0x02,0x00,0x41,0x00,0x53,0xFF,0xFF,0xFF,0x4F,0x52,0x00,0x4F,0x52,0x00,0x45,0x3B,0x0B,0x02,0x0D,0x00,0xFF,0x40}, 30, 0},
    {0xC3, (uint8_t[]){0x00,0x00,0x00,0x50,0x03,0x00,0x00,0x00,0x01,0x80,0x01}, 11, 0},
    {0xC4, (uint8_t[]){0x00,0x24,0x33,0x80,0x00,0xEA,0x64,0x32,0xC8,0x64,0xC8,0x32,0x90,0x90,0x11,0x06,0xDC,0xFA,0x00,0x00,0x80,0xFE,0x10,0x10,0x00,0x0A,0x0A,0x44,0x50}, 29, 0},
    {0xC5, (uint8_t[]){0x18,0x00,0x00,0x03,0xFE,0x3A,0x4A,0x20,0x30,0x10,0x88,0xDE,0x0D,0x08,0x0F,0x0F,0x01,0x3A,0x4A,0x20,0x10,0x10,0x00}, 23, 0},
    {0xC6, (uint8_t[]){0x05,0x0A,0x05,0x0A,0x00,0xE0,0x2E,0x0B,0x12,0x22,0x12,0x22,0x01,0x03,0x00,0x3F,0x6A,0x18,0xC8,0x22}, 20, 0},
    {0xC7, (uint8_t[]){0x50,0x32,0x28,0x00,0xA2,0x80,0x8F,0x00,0x80,0xFF,0x07,0x11,0x9C,0x67,0xFF,0x24,0x0C,0x0D,0x0E,0x0F}, 20, 0},
    {0xC9, (uint8_t[]){0x33,0x44,0x44,0x01}, 4, 0},
    {0xCF, (uint8_t[]){0x2C,0x1E,0x88,0x58,0x13,0x18,0x56,0x18,0x1E,0x68,0x88,0x00,0x65,0x09,0x22,0xC4,0x0C,0x77,0x22,0x44,0xAA,0x55,0x08,0x08,0x12,0xA0,0x08}, 27, 0},
    {0xD5, (uint8_t[]){0x40,0x8E,0x8D,0x01,0x35,0x04,0x92,0x74,0x04,0x92,0x74,0x04,0x08,0x6A,0x04,0x46,0x03,0x03,0x03,0x03,0x82,0x01,0x03,0x00,0xE0,0x51,0xA1,0x00,0x00,0x00}, 30, 0},
    {0xD6, (uint8_t[]){0x10,0x32,0x54,0x76,0x98,0xBA,0xDC,0xFE,0x93,0x00,0x01,0x83,0x07,0x07,0x00,0x07,0x07,0x00,0x03,0x03,0x03,0x03,0x03,0x03,0x00,0x84,0x00,0x20,0x01,0x00}, 30, 0},
    {0xD7, (uint8_t[]){0x03,0x01,0x0B,0x09,0x0F,0x0D,0x1E,0x1F,0x18,0x1D,0x1F,0x19,0x40,0x8E,0x04,0x00,0x20,0xA0,0x1F}, 19, 0},
    {0xD8, (uint8_t[]){0x02,0x00,0x0A,0x08,0x0E,0x0C,0x1E,0x1F,0x18,0x1D,0x1F,0x19}, 12, 0},
    {0xD9, (uint8_t[]){0x1F,0x1F,0x1F,0x1F,0x1F,0x1F,0x1F,0x1F,0x1F,0x1F,0x1F,0x1F}, 12, 0},
    {0xDD, (uint8_t[]){0x1F,0x1F,0x1F,0x1F,0x1F,0x1F,0x1F,0x1F,0x1F,0x1F,0x1F,0x1F}, 12, 0},
    {0xDF, (uint8_t[]){0x44,0x73,0x4B,0x69,0x00,0x0A,0x02,0x90}, 8, 0},
    {0xE0, (uint8_t[]){0x3B,0x28,0x10,0x16,0x0C,0x06,0x11,0x28,0x5C,0x21,0x0D,0x35,0x13,0x2C,0x33,0x28,0x0D}, 17, 0},
    {0xE1, (uint8_t[]){0x37,0x28,0x10,0x16,0x0B,0x06,0x11,0x28,0x5C,0x21,0x0D,0x35,0x14,0x2C,0x33,0x28,0x0F}, 17, 0},
    {0xE2, (uint8_t[]){0x3B,0x07,0x12,0x18,0x0E,0x0D,0x17,0x35,0x44,0x32,0x0C,0x14,0x14,0x36,0x3A,0x2F,0x0D}, 17, 0},
    {0xE3, (uint8_t[]){0x37,0x07,0x12,0x18,0x0E,0x0D,0x17,0x35,0x44,0x32,0x0C,0x14,0x14,0x36,0x32,0x2F,0x0F}, 17, 0},
    {0xE4, (uint8_t[]){0x3B,0x07,0x12,0x18,0x0E,0x0D,0x17,0x39,0x44,0x2E,0x0C,0x14,0x14,0x36,0x3A,0x2F,0x0D}, 17, 0},
    {0xE5, (uint8_t[]){0x37,0x07,0x12,0x18,0x0E,0x0D,0x17,0x39,0x44,0x2E,0x0C,0x14,0x14,0x36,0x3A,0x2F,0x0F}, 17, 0},
    {0xA4, (uint8_t[]){0x85,0x85,0x95,0x82,0xAF,0xAA,0xAA,0x80,0x10,0x30,0x40,0x40,0x20,0xFF,0x60,0x30}, 16, 0},
    {0xA4, (uint8_t[]){0x85,0x85,0x95,0x85}, 4, 0},
    {0xBB, (uint8_t[]){0x00,0x00,0x00,0x00,0x00,0x00,0x00,0x00}, 8, 0},
    {0x13, (uint8_t[]){0x00}, 0, 0},
    {0x11, (uint8_t[]){0x00}, 0, 120},
    {0x2C, (uint8_t[]){0x00,0x00,0x00,0x00}, 4, 0},
};

static void backlight_init(uint8_t pct) {
    ledc_timer_config_t t = {};
    t.speed_mode = LEDC_LOW_SPEED_MODE; t.duty_resolution = LEDC_TIMER_10_BIT;
    t.timer_num = LEDC_TIMER_1; t.freq_hz = 5000; t.clk_cfg = LEDC_AUTO_CLK;
    ledc_timer_config(&t);
    ledc_channel_config_t c = {};
    c.gpio_num = PIN_BL; c.speed_mode = LEDC_LOW_SPEED_MODE;
    c.channel = LEDC_CHANNEL_1; c.timer_sel = LEDC_TIMER_1;
    c.duty = (1023u * pct) / 100u; c.hpoint = 0;
    ledc_channel_config(&c);
}

static void paint(uint16_t c565) {
    const size_t N = (size_t)LCD_W * LCD_H;
    uint16_t* buf = (uint16_t*)ps_malloc(N * sizeof(uint16_t));
    if (!buf) { Serial.println("alloc fail"); return; }
    uint16_t sw = __builtin_bswap16(c565);
    for (size_t i = 0; i < N; ++i) buf[i] = sw;
    esp_lcd_panel_draw_bitmap(g_panel, 0, 0, LCD_W, LCD_H, buf);
    free(buf);
}

void setup() {
    Serial.begin(115200);
    delay(300);
    Serial.println("\n=== VENDOR DRIVER + CUSTOM SHIM ===");

    backlight_init(100);
    Wire.begin(PIN_SDA, PIN_SCL);
    Wire.setClock(400000);

    // SPI bus. CS is driven by the peripheral (not GPIO) so our shim can use
    // SPI_TRANS_CS_KEEP_ACTIVE to hold CS across the 32-bit cmd + data chunks,
    // matching stock esp_lcd_panel_io_spi behavior.
    spi_bus_config_t bcfg = {};
    bcfg.mosi_io_num = PIN_QSPI_D0;
    bcfg.miso_io_num = PIN_QSPI_D1;
    bcfg.sclk_io_num = PIN_QSPI_SCK;
    bcfg.quadwp_io_num = PIN_QSPI_D2;
    bcfg.quadhd_io_num = PIN_QSPI_D3;
    bcfg.max_transfer_sz = 4096;
    bcfg.flags = SPICOMMON_BUSFLAG_MASTER | SPICOMMON_BUSFLAG_GPIO_PINS
               | SPICOMMON_BUSFLAG_QUAD;   // force D2/D3 to be driven as outputs
    esp_err_t r = spi_bus_initialize(SPI2_HOST, &bcfg, SPI_DMA_CH_AUTO);
    Serial.printf("[bsp] spi_bus_initialize -> %d\n", r);

    spi_device_interface_config_t dcfg = {};
    dcfg.command_bits = 0;
    dcfg.address_bits = 0;
    dcfg.mode           = 3;
    dcfg.clock_speed_hz = 40 * 1000 * 1000;
    dcfg.spics_io_num   = PIN_QSPI_CS;   // peripheral-driven CS for KEEP_ACTIVE
    dcfg.queue_size     = 10;             // stock esp_lcd uses 10
    dcfg.flags          = SPI_DEVICE_HALFDUPLEX;
    r = spi_bus_add_device(SPI2_HOST, &dcfg, &g_spi);
    Serial.printf("[bsp] spi_bus_add_device -> %d\n", r);

    // Create our custom panel_io, then hand it to the vendor panel driver.
    r = my_panel_io_new(g_spi, PIN_QSPI_CS, &g_io);
    Serial.printf("[bsp] my_panel_io_new -> %d\n", r);

    axs15231b_vendor_config_t vcfg = {};
    // Let the panel driver use its built-in `vendor_specific_init_default`
    // table (passing NULL init_cmds). That's the "type 1" 320x480 init which
    // ends with DISPON + ALLPOFF(0x22). The esp_bsp.c override table we used
    // before ends without ALLPOFF which may leave the chip in an indeterminate
    // DDRAM-display state producing our noise symptom.
    vcfg.init_cmds      = NULL;
    vcfg.init_cmds_size = 0;
    vcfg.flags.use_qspi_interface = 1;
    esp_lcd_panel_dev_config_t pcfg = {};
    pcfg.reset_gpio_num = -1;
    pcfg.color_space    = LCD_RGB_ELEMENT_ORDER_RGB;
    pcfg.bits_per_pixel = 16;
    pcfg.vendor_config  = &vcfg;
    r = esp_lcd_new_panel_axs15231b(g_io, &pcfg, &g_panel);
    Serial.printf("[bsp] new_panel_axs15231b -> %d\n", r);

    esp_lcd_panel_reset(g_panel);
    esp_lcd_panel_init(g_panel);
    esp_lcd_panel_disp_on_off(g_panel, true);
    Serial.println("[bsp] panel on");

    const struct { uint16_t c; const char* n; } seq[] = {
        {0xF800,"RED"},{0x07E0,"GREEN"},{0x001F,"BLUE"},
        {0xFFFF,"WHITE"},{0x0000,"BLACK"},
    };
    for (auto& s : seq) { Serial.printf("paint %s\n", s.n); paint(s.c); delay(800); }
    Serial.println("halted");
}

static bool touch_down() {
    static const uint8_t cmd[11] = { 0xB5,0xAB,0xA5,0x5A, 0x00,0x00, 0x00,0x08, 0x00,0x00,0x00 };
    Wire.beginTransmission(0x3B);
    Wire.write(cmd, sizeof(cmd));
    if (Wire.endTransmission() != 0) return false;
    uint8_t b[8] = {0};
    size_t got = Wire.requestFrom((uint8_t)0x3B, (uint8_t)8);
    if (got < 6) return false;
    for (size_t i = 0; i < got && i < sizeof(b); ++i) b[i] = Wire.read();
    return (b[0] == 0) && ((b[1] & 0x0F) != 0);
}

void loop() {
    if (touch_down()) { Serial.println("touch → restart"); delay(50); ESP.restart(); }
    delay(30);
}

#endif  // BOARD_IS_JC3248W535_VENDOR
